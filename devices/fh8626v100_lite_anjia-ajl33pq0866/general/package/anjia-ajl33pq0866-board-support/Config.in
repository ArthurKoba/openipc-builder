## devices/fh8626v100_lite_anjia-ajl33pq0866/general/package/anjia-ajl33pq0866-board-support/Config.in
```kconfig
config BR2_PACKAGE_ANJIA_AJL33PQ0866_BOARD_SUPPORT
	bool "anjia-ajl33pq0866-board-support"
	depends on BR2_arm
	help
	  Device-specific hardware backends for the ANJIA AJL33PQ0866 camera
	  with Fullhan FH8626V100.

	  Provides a stateless /dev/fh_pwm pan/tilt backend compatible with the
	  standard OpenIPC gpio-motors relative-move interface, plus an independent
	  low-level GPIO4/GPIO14 WIDE/TELE selector.

	  The package deliberately does not calibrate or move PTZ at boot and does
	  not persist inferred motor coordinates. Higher-level lens/media policy
	  remains owned by the selected runtime.

config BR2_PACKAGE_ANJIA_AJL33PQ0866_TARGET_NAME
	string
	default "fh8626v100_lite_anjia-ajl33pq0866"
	depends on BR2_PACKAGE_ANJIA_AJL33PQ0866_BOARD_SUPPORT
	help
	  Exact Builder target name embedded into the image for device-scoped
	  update identity. Runtime direction defconfigs override this when needed.
```

## package/anjia-ajl33pq0866-board-support/Config.in
```kconfig
config BR2_PACKAGE_ANJIA_AJL33PQ0866_BOARD_SUPPORT
	bool "anjia-ajl33pq0866-board-support"
	depends on BR2_arm
	help
	  Device-specific hardware backends for the ANJIA AJL33PQ0866 camera
	  with Fullhan FH8626V100.

	  Provides a stateless /dev/fh_pwm pan/tilt backend compatible with the
	  standard OpenIPC gpio-motors relative-move interface, plus an independent
	  low-level GPIO4/GPIO14 WIDE/TELE selector.

	  The package deliberately does not calibrate or move PTZ at boot and does
	  not persist inferred motor coordinates. Higher-level lens/media policy
	  remains owned by the selected runtime.
```

## package/anjia-ajl33pq0866-divinus-config/Config.in
```kconfig
config BR2_PACKAGE_ANJIA_AJL33PQ0866_DIVINUS_CONFIG
	bool "anjia-ajl33pq0866-divinus-config"
	depends on BR2_PACKAGE_DIVINUS
	help
	  Divinus runtime defaults for the ANJIA AJL33PQ0866 named device.

	  This package contains no FH8626 implementation code. It exists only so
	  the Divinus target can install its device-specific /etc/divinus.yaml
	  without leaking that runtime configuration into the shared ANJIA overlay
	  or the Majestic target.
```

## package/majestic-fh8852v200-compat/Config.in
```kconfig
config BR2_PACKAGE_MAJESTIC_FH8852V200_COMPAT
	bool "Majestic FH8852V200 compatibility experiment"
	depends on BR2_arm
	depends on BR2_TOOLCHAIN_USES_MUSL
	select BR2_PACKAGE_JSON_C
	select BR2_PACKAGE_LIBEVENT_OPENIPC
	select BR2_PACKAGE_LIBOGG_OPENIPC
	select BR2_PACKAGE_LIBYAML
	select BR2_PACKAGE_MBEDTLS_OPENIPC
	select BR2_PACKAGE_OPUS_OPENIPC
	help
	  Experimental FH8852V200 Majestic userspace on FH8626V100.
	  Installs no FH8852 kernel modules or firmware.
	  FH8852 userspace libraries are isolated under
	  /usr/lib/majestic-fh8852v200.
	  Majestic is not started automatically.
```
